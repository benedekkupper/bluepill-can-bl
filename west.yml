## west.yml
```yaml
manifest:
  self:
    path: bluepill-can-bl

  projects:
    - name: zephyr
      url: https://github.com/zephyrproject-rtos/zephyr.git
      revision: v4.3.0
      clone-depth: 1
      import:
        name-allowlist:
          - cmsis_6
          - hal_stm32

    - name: bitfilled
      url: https://github.com/IntergatedCircuits/bitfilled.git
      revision: a4aa48e0fa7568880a297825c9ce4bf691f641eb

    - name: stm32header
      url: https://github.com/IntergatedCircuits/stm32header.git
      revision: 6c3d30b9332bca15a2df4dceff13db626eea6ff3
```

## zephyr/Kconfig
```kconfig
config BOOTLOADER_BLUEPILL_CAN
    bool "Enable Blue-pill CAN Bootloader"
    depends on SOC_STM32F103X8
    select USE_DT_CODE_PARTITION
    select INIT_ARCH_HW_AT_BOOT if ARCH_SUPPORTS_ARCH_HW_INIT
    imply REBOOT
    select CPP
    select REQUIRES_FULL_LIBCPP

    help
        Enable the Blue-pill CAN Bootloader.

if BOOTLOADER_BLUEPILL_CAN

choice STD_CPP
	default STD_CPP20
endchoice

endif
```

## zephyr/sysbuild/Kconfig
```kconfig
menu "Blue-pill CAN Bootloader Configuration"

config BOOTLOADER_BLUEPILL_CAN
    bool "Enable Blue-pill CAN Bootloader"
    depends on SUPPORT_BOOTLOADER
    help
        Enable the Blue-pill CAN Bootloader.

config BLUEPILL_CAN_BUS_BITRATE
    int "CAN bus baud rate"
    # default $(dt_nodelabel_int_prop,can1,bitrate)
    help
        Baud rate for the CAN bus in bits per second.

config BLUEPILL_HSE_CLOCK_HZ
    int "HSE Clock Frequency"
    default 8000000
    help
        Frequency of the High-Speed External (HSE) clock in Hertz.

endmenu
```
