## CMakeLists.txt
```
cmake_minimum_required(VERSION 3.21)

# set this before including Zephyr
set_property(GLOBAL APPEND PROPERTY
    HEX_FILES_TO_MERGE
        "${CMAKE_BINARY_DIR}/../bootloader/bluepill-can-bl.hex"
        "${CMAKE_BINARY_DIR}/zephyr/zephyr.hex"
)

find_package(Zephyr REQUIRED HINTS $ENV{ZEPHYR_BASE})
project(bluepill-app
    # set VERSION in ./VERSION file
)

target_sources(app PRIVATE src/main.cpp)
target_link_libraries(app PRIVATE can_bl_interface)
```

## sysbuild.conf
```
SB_CONFIG_BOOTLOADER_BLUEPILL_CAN=y
SB_CONFIG_BLUEPILL_CAN_BUS_BITRATE=250000
```

## prj.conf
```kconfig
CONFIG_PRINTK=y
CONFIG_SHELL=y
CONFIG_SHELL_MINIMAL=y
CONFIG_SHELL_STACK_SIZE=1024
CONFIG_SHELL_BACKEND_SERIAL=y
CONFIG_APP_VERSION_SHELL=y

CONFIG_THREAD_MONITOR=y
CONFIG_INIT_STACKS=y
CONFIG_BOOT_BANNER=n
CONFIG_THREAD_NAME=y
CONFIG_LOG=n
CONFIG_CBPRINTF_NANO=y
```

## boards/stm32_min_dev@blue.overlay
```dts
/ {
    chosen {
        zephyr,canbus = &can1;
    };
};

&can1 {
    status = "okay";
    bus-speed = <250000>;
    pinctrl-names = "default";
    pinctrl-0 = <&can1_remap_pb8_pb9>;
};
```

## src/main.cpp
```c
#include "app_version.h"
#include <can_bl/boot.hpp>
#include <zephyr/kernel.h>
#include <zephyr/shell/shell.h>
#include <zephyr/sys/printk.h>
#include <zephyr/sys/reboot.h>

static int cmd_boot_to_update(const shell* sh, [[maybe_unused]] size_t argc,
                              [[maybe_unused]] char** argv)
{
    can_bl::set_update_request();

    sys_reboot(SYS_REBOOT_COLD);
    return 0;
}

SHELL_STATIC_SUBCMD_SET_CREATE(sub_image,
                               SHELL_CMD(update, NULL, "Boot to update mode", cmd_boot_to_update),
                               SHELL_SUBCMD_SET_END /* Array terminated. */
);
SHELL_CMD_REGISTER(image, &sub_image, "Image commands", NULL);

int main()
{
    printk("Application version %s\n", APP_VERSION_EXTENDED_STRING);
    return 0;
}
```
